/dts-v1/;
/plugin/;
/ {
        compatible = "brcm,bcm2712";
        fragment@0 {
                target = <&i2c1>;
                __overlay__ {
                        #address-cells = <1>;
                        #size-cells = <0>;

                        d6t: d6t@0A {
                                compatible = "omron,d6t";
                                reg = <0x0A>;
                                status = "okay";    
                        };
                };
        };
};
