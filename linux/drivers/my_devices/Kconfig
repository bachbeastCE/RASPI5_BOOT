## linux/drivers/my_devices/Kconfig
```kconfig
# SPDX-License-Identifier: GPL-2.0
#
# Makefile for my_devices drivers
# 
# drivers/my_devices/Kconfig

menu "Custom Sensor Support"

config MY_DEVICES
    bool "Enable custom sensor drivers"
    default y
    help
      Enable this to see the list of custom drivers developed for Raspi 5.

if MY_DEVICES

source "drivers/my_devices/bh1750/Kconfig"
source "drivers/my_devices/d6t/Kconfig"
source "drivers/my_devices/sx1278/Kconfig"

endif # MY_DEVICES

endmenu
```

## linux/drivers/my_devices/bh1750/Kconfig
```kconfig
# SPDX-License-Identifier: GPL-2.0
#
# Sensor BH1750 driver configuration
#

config SENSOR_BH1750
	tristate "ROHM BH1750 ambient light sensor support"
    default n
	depends on I2C
	help
	  Say Y here if you want to support the ROHM BH1750 ambient light sensor.
	  This sensor is commonly used in IoT and embedded projects like Raspberry Pi.

	  To compile this driver as a module, choose M here: the
	  module will be called bh1750.
```

## linux/drivers/my_devices/d6t/Kconfig
```kconfig
# SPDX-License-Identifier: GPL-2.0
#
# Sensor D6T driver configuration
#

config SENSOR_D6T
    tristate "Omron D6T MEMS Thermal Sensor support"
    default n
    depends on I2C
    help
      Say Y here if you want to support the Omron D6T series non-contact
      MEMS thermal sensors. These sensors use I2C to provide thermal
      data (1x1, 1x8, or 4x4 pixels) for human detection or temperature
      measurement.

      To compile this driver as a module, choose M here: the
      module will be called d6t.
```

## linux/drivers/my_devices/sx1278/Kconfig
```kconfig
# SPDX-License-Identifier: GPL-2.0
#
# Sensor Semtech LoRa SX1278 driver configuration
#

config LORA_SX1278
    tristate "Semtech SX1278 LoRa module support"
    default n
    depends on SPI
    help
      Say Y here if you want to support the Semtech SX1278 (Ra-02) LoRa module.
      This module is commonly used for long-range wireless communication.

      To compile this driver as a module, choose M here: the
      module will be called sx1278.
```
